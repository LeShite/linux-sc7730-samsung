## drivers/pmdomain/sprd/Kconfig
```kconfig
# SPDX-License-Identifier: GPL-2.0-only

config SPRD_SC8830_GPU_PD
	bool "Spreadtrum SC8830 family GPU power domain"
	depends on ARCH_SPRD || COMPILE_TEST
	depends on PM
	select PM_GENERIC_DOMAINS
	help
	  Powers up the Mali-400 GPU of 32-bit Spreadtrum SC8830 family SoCs
	  such as the SC7730, so that the Lima driver can use it.
```

## sound/arm/Kconfig
```kconfig
# SPDX-License-Identifier: GPL-2.0-only
# ALSA ARM drivers

menuconfig SND_ARM
	bool "ARM sound devices"
	depends on ARM
	default y
	help
	  Support for sound devices specific to ARM architectures.
	  Drivers that are implemented on ASoC can be found in
	  "ALSA for SoC audio support" section.

if SND_ARM

config SND_ARMAACI
	tristate "ARM PrimeCell PL041 AC Link support"
	depends on ARM_AMBA
	select SND_PCM
	select SND_AC97_CODEC

config SND_SC8830
	tristate "Spreadtrum SC8830 (SC7730) VBC and SC2723S codec"
	depends on ARCH_SPRD || COMPILE_TEST
	depends on HAS_DMA
	select SND_PCM
	help
	  Speaker playback through the VBC, the AP DMA and the codec inside
	  the SC2723S PMIC, as on the Samsung Galaxy Tab A 7.0 (SM-T280).

config SND_PXA2XX_AC97
	tristate "AC97 driver for the Intel PXA2xx chip"
	depends on ARCH_PXA
	select SND_AC97_CODEC
	select SND_PXA2XX_LIB
	select SND_PXA2XX_LIB_AC97
	help
	  Say Y or M if you want to support any AC97 codec attached to
	  the PXA2xx AC97 interface.

endif	# SND_ARM

config SND_PXA2XX_LIB
	tristate
	select SND_DMAENGINE_PCM

config SND_PXA2XX_LIB_AC97
	bool
```
